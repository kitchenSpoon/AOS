## apps/print5/Kconfig
```kconfig
#
# Copyright 2014, NICTA
#
# This software may be distributed and modified according to the terms of
# the BSD 2-Clause license. Note that NO WARRANTY is provided.
# See "LICENSE_BSD2.txt" for details.
#
# @TAG(NICTA_BSD)
#

config APP_PRINT5
    bool "Print5"
    depends on LIB_SEL4 && HAVE_LIBC && LIB_SOS
    select HAVE_SEL4_APPS
    help
        Wooo another new app
```

## apps/print5_loop/Kconfig
```kconfig
#
# Copyright 2014, NICTA
#
# This software may be distributed and modified according to the terms of
# the BSD 2-Clause license. Note that NO WARRANTY is provided.
# See "LICENSE_BSD2.txt" for details.
#
# @TAG(NICTA_BSD)
#

config APP_PRINT5_LOOP
    bool "Print5 loop"
    depends on LIB_SEL4 && HAVE_LIBC && LIB_SOS
    select HAVE_SEL4_APPS
    help
        Wooo new app
```
